## src/Kconfig
```kconfig
mainmenu "LambdaSoC BIOS Configuration"

source src/arch/Kconfig

source src/drivers/Kconfig

menu "Memory regions"

config BOOTROM_BASE
	hex "Boot ROM base address"

config BOOTROM_LIMIT
	hex "Boot ROM limit address"

config SCRATCHPAD_BASE
	hex "Scratchpad base address"

config SCRATCHPAD_LIMIT
	hex "Scratchpad limit address"

config UART_BASE
	hex "UART base address"

config UART_LIMIT
	hex "UART limit address"

config TIMER_BASE
	hex "Timer base address"

config TIMER_LIMIT
	hex "Timer limit address"

if SOC_WITH_SDRAM

config SDRAM_BASE
	hex "SDRAM base address"

config SDRAM_LIMIT
	hex "SDRAM limit address"

endif # SOC_WITH_SDRAM

if SOC_WITH_SRAM

config SRAM_BASE
	hex "SRAM base address"

config SRAM_LIMIT
	hex "SRAM limit address"

endif # SOC_WITH_SRAM

if SOC_WITH_ETHMAC

config ETHMAC_BASE
	hex "Ethernet MAC base address"

config ETHMAC_LIMIT
	hex "Ethernet MAC limit address"

endif # SOC_WITH_ETHMAC

endmenu

menu "SoC"

config SOC_CLOCK_FREQ
	int "System clock frequency (in Hz)"

config SOC_CSR_DATA_WIDTH
	int "Control/Status register data width (in bits)"
	default 32

config SOC_WITH_SDRAM
	bool "Enable SDRAM support"

config SOC_WITH_SRAM
	bool "Enable SRAM support"

config SOC_WITH_ETHMAC
	bool "Enable Ethernet MAC support"

endmenu
```

## src/arch/Kconfig
```kconfig
source src/arch/riscv/Kconfig

menu "CPU"

choice
	prompt "CPU"
	default CPU_MINERVA

config CPU_MINERVA
	bool "Minerva"
	select CPU_ARCH_RISCV

endchoice

config CPU_BYTEORDER_LITTLE
	bool
	default "y" if CPU_MINERVA

config CPU_RESET_ADDR
	hex "Reset vector address"

config CPU_DATA_WIDTH
	int
	default 32 if CPU_MINERVA

endmenu
```

## src/arch/riscv/Kconfig
```kconfig
config CPU_ARCH_RISCV
	bool

if CPU_ARCH_RISCV

config CPU_RISCV_TRIPLE
	string #"Toolchain triple" FIXME
	default "riscv64-unknown-elf"

config CPU_RISCV_MULDIV_SOFT
	bool "Emulate support for integer multiplication and division"
	default y

endif # if CPU_ARCH_RISCV
```

## src/drivers/Kconfig
```kconfig
menu "Drivers"

source src/drivers/ethmac/Kconfig
source src/drivers/intc/Kconfig
source src/drivers/sdram/Kconfig
source src/drivers/sram/Kconfig
source src/drivers/timer/Kconfig
source src/drivers/uart/Kconfig

endmenu
```

## src/drivers/ethmac/Kconfig
```kconfig
menu "Ethernet MAC"

if SOC_WITH_ETHMAC

config ETHMAC_CTRL_OFFSET
	hex "CSR window offset"

config ETHMAC_DATA_OFFSET
	hex "Data window offset"

config ETHMAC_RX_SLOTS
	int "Number of RX slots"

config ETHMAC_TX_SLOTS
	int "Number of TX slots"

config ETHMAC_SLOT_SIZE
	int "Slot size (in bytes)"
	default 2048

config ETHMAC_LOCAL_IP
	int "Local IPv4 address"

config ETHMAC_REMOTE_IP
	int "Remote IPv4 address"

endif # SOC_WITH_ETHMAC

endmenu
```

## src/drivers/intc/Kconfig
```kconfig
menu "Interrupt Controller"

config INTC_TIMER_IRQ
	int "Timer IRQ index"

config INTC_UART_IRQ
	int "UART IRQ index"

config INTC_ETHMAC_IRQ
	int "Ethernet MAC IRQ index"
	depends on SOC_WITH_ETHMAC

endmenu
```

## src/drivers/sdram/Kconfig
```kconfig
menu "SDRAM"

if SOC_WITH_SDRAM

config SDRAM_SIZE
	int "SDRAM size (in bytes)"

config SDRAM_CACHE_SIZE
	int "SDRAM cache size (in bytes)"

endif # SOC_WITH_SDRAM

endmenu
```

## src/drivers/sram/Kconfig
```kconfig
menu "Static RAM"

config BOOTROM_SIZE
	int "Boot ROM size (bytes)"

config SCRATCHPAD_SIZE
	int "Scratchpad size (bytes)"

endmenu
```
